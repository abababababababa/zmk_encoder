## Kconfig
```kconfig
# Copyright (c) 2024 ec_msc contributors
# SPDX-License-Identifier: MIT

config ZMK_BEHAVIOR_EC_MSC
    bool "EC11 encoder single-shot mouse scroll behavior"
    default y
    depends on ZMK_MOUSE
    help
      Enables the ec_msc behavior which sends a single HID scroll event
      (press + immediate release) per encoder notch.  Unlike the stock
      ZMK scroll behavior, it never leaves a "stuck" release pending if
      a sensor event is lost mid-flight.
```

## dts/bindings/behavior-sensor-adapter.yaml
```yaml
description: Sensor adapter behavior

compatible: "zmk,behavior-sensor-adapter"

include: base.yaml

properties:
  x-code:
    type: int
    required: false

  y-code:
    type: int
    required: false
```

## dts/bindings/zmk,behavior-ec-msc.yaml
```yaml
# Copyright (c) 2024 ec_msc contributors
# SPDX-License-Identifier: MIT

description: EC11 encoder single-shot mouse scroll behavior

compatible: "zmk,behavior-ec-msc"

properties:
  "#sensor-binding-cells":
    type: int
    required: true
    const: 2
  msc-behavior:
    type: phandle
    required: true
    description: >
      Phandle to the &msc behavior node (zmk,behavior-input-two-axis).
      This resolves the correct device pointer at compile time.

sensor-binding-cells:
  - param1
  - param2
```

## dts/bindings/zmk,behavior-sensor-adapter.yaml
```yaml
description: Sensor adapter behavior

compatible: "zmk,behavior-sensor-adapter"

include: base.yaml

sensor-binding-cells:
  - inc_binding
  - dec_binding

properties:
  x-code:
    type: int
    required: false

  y-code:
    type: int
    required: false
```

## west.yml
```yaml
manifest:
  remotes:
    - name: zmkfirmware
      url-base: https://github.com/zmkfirmware
    - name: zmk_encoder
      url-base: https://github.com/abababababababa

  projects:
    - name: zmk
      remote: zmkfirmware
      revision: main
      import: app/west.yml

    - name: zmk_encoder
      remote: zmk_encoder
      revision: main
      path: modules/zmk_encoder
      import: false

  self:
    path: config
```
